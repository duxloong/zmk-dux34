## boards/shields/dux34/Kconfig.defconfig
```kconfig
if SHIELD_DUX34

config ZMK_KEYBOARD_NAME
    default "dux34"

# 当启用自定义 LED widget 时，自动启用依赖项
if DUX34_LED_WIDGET

config ZMK_BATTERY_REPORTING
    default y

config ZMK_LOW_PRIORITY_WORK_QUEUE
    default y

config LED_STRIP
    default y

config SPI
    default y

endif # DUX34_LED_WIDGET

endif # SHIELD_DUX34
```

## boards/shields/dux34/Kconfig.shield
```kconfig
config SHIELD_DUX34
    def_bool $(shields_list_contains,dux34)

# DUX34 专属 LED 状态指示 widget
config DUX34_LED_WIDGET
    bool "DUX34 WS2812 LED battery/charging status widget"
    depends on SHIELD_DUX34
    select LED_STRIP
    select SPI
    select ZMK_BATTERY_REPORTING
    help
      Enable WS2812 RGB LED status indicator on D1 pin (P0.06, via SPI3):
        Yellow = Charging (USB connected, battery < 100%)
        Blue   = Fully charged (USB connected, battery = 100%)
        Red    = Low battery (battery < 20%)
        Off    = Normal use

      Uses a dedicated work queue (not ZMK's low-priority queue)
      to avoid stack overflow during SPI operations.
```

## config/west.yml
```yaml
manifest:
  defaults:
    revision: v0.3
  remotes:
    - name: zmkfirmware
      url-base: https://github.com/zmkfirmware
    - name: ergohaven
      url-base: https://github.com/ergohaven
    # Additional modules containing boards/shields/custom code can be listed here as well
    # See https://docs.zephyrproject.org/3.2.0/develop/west/manifest.html#projects
  projects:
    - name: zmk
      remote: zmkfirmware
      revision: main
      import: app/west.yml
    - name: zmk-smart-rgbled-widget
      remote: ergohaven
      revision: main
      path: modules/zmk-smart-rgbled-widget
  self:
    path: config
```
